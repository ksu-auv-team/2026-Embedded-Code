  #include <Arduino.h>
#include <Wire.h>

// ============================================================================
// STM32G431KBT6 (LQFP32) - 8 Channel I2C ESC Controller
//
// I2C frame: 9 bytes -> [0]=header (always 0), [1..8]=ESC1..ESC8 (0-255)
// Output:    real hardware PWM, 50 Hz, 1200-1800us, generated by TIM1/2/3.
// ============================================================================

// ---------------------------------------------------------------------------
// CONFIGURATION
// ---------------------------------------------------------------------------

// I2C
#define I2C_ADDRESS           0x4c
#define I2C_DATA_LENGTH       9         // 1 header byte + 8 PWM values
#define I2C_HEADER_VALUE      0x00      // First byte must be 0
#define NUM_THRUSTERS         8

// I2C2 on PA9 (SCL) / PA8 (SDA).  On the LQFP32 G431 these pins map ONLY to
// I2C2 (SCL=AF4, SDA=AF4).  The stm32duino core has a single global `Wire`
// object whose peripheral is chosen from the pins you hand it, so setting
// these pins is what selects I2C2 -- there is no `Wire1` in this core.
#define I2C_SCL_PIN           PA9
#define I2C_SDA_PIN           PA8

// Serial
#define ENABLE_SERIAL         0         // Set to 0 to disable all serial output

// LED
#define LED_PIN               PA0
#define LED_ACTIVE_HIGH       1         // Set to 0 if LED is wired active-low
#define LED_BOOT_FLASH_PERIOD 150       // Fast flash period during boot (ms)
#define LED_BOOT_FLASH_DURATION 2000    // Duration of boot flash (ms)
#define LED_I2C_FLASH_PERIOD  30        // Length of the flash on each I2C write (ms)

// Thruster PWM
#define THRUSTER_FREQUENCY    50        // Hz
#define THRUSTER_MIN_US       1112
#define THRUSTER_MAX_US       1912
#define THRUSTER_NEUTRAL_US   1512

// Test mode
#define ENABLE_THRUSTER_TEST_MODE 0       // Set to 1 to run a channel-by-channel test sweep
#define THRUSTER_TEST_PULSE_US    1800    // Pulse width applied to each channel in test mode
#define THRUSTER_TEST_STEP_MS     1000     // Time to hold each channel at the test pulse
#define THRUSTER_TEST_IDLE_US     THRUSTER_NEUTRAL_US

// Timing
#define STARTUP_DELAY_MS      5000      // Hold neutral on startup (ESC arming)
#define I2C_TIMEOUT_MS        2000      // Failsafe: no I2C for this long -> neutral
#define CYCLE_TIME_MS         5         // Main loop cycle time

// ---------------------------------------------------------------------------
// PWM BACKEND
//
// Every ESC pin is driven by a real timer compare channel. Pin -> timer map
// for the G431 LQFP32 (from the variant's PinMap_TIM):
//
//   PA1  TIM2_CH2      PA5  TIM2_CH1
//   PA2  TIM2_CH3      PA6  TIM3_CH1
//   PA3  TIM2_CH4      PA7  TIM1_CH1N   <-- complementary output
//   PA4  TIM3_CH2      PA10 TIM1_CH3
//
// Note PA7 is a *complementary* (N) channel. HardwareTimer detects this from
// the pin and starts it with HAL_TIMEx_PWMN_Start(), which also enables the
// advanced-timer main output (MOE) -- so it produces a correct, non-inverted
// pulse just like the others. Nothing special is needed here beyond passing
// the pin in, but do NOT remap PA7 to its TIM3_CH2 alternate: that would
// collide with PA4.
// ---------------------------------------------------------------------------

struct ThrusterChannel {
  PinName     pin;      // PinName (PA_1) not pin number -- HardwareTimer wants this
  TIM_TypeDef *timer;   // Owning timer instance
  uint32_t    channel;  // Compare channel (1-4); N-ness is derived from the pin
};

static ThrusterChannel thrusters[NUM_THRUSTERS] = {
  { PA_1,  TIM2, 2 },   // ESC 1
  { PA_2,  TIM2, 3 },   // ESC 2
  { PA_3,  TIM2, 4 },   // ESC 3
  { PA_4,  TIM3, 2 },   // ESC 4
  { PA_5,  TIM2, 1 },   // ESC 5
  { PA_6,  TIM3, 1 },   // ESC 6
  { PA_7,  TIM1, 1 },   // ESC 7  (TIM1_CH1N, complementary)
  { PA_10, TIM1, 3 },   // ESC 8
};

// One HardwareTimer per distinct timer. Channels on the same timer share the
// period, which is exactly what we want (all 8 outputs at a common 50 Hz).
static HardwareTimer *timTIM1 = nullptr;
static HardwareTimer *timTIM2 = nullptr;
static HardwareTimer *timTIM3 = nullptr;

static HardwareTimer *timerFor(TIM_TypeDef *t) {
  if (t == TIM1) return timTIM1;
  if (t == TIM2) return timTIM2;
  if (t == TIM3) return timTIM3;
  return nullptr;
}

// ---------------------------------------------------------------------------
// GLOBALS
// ---------------------------------------------------------------------------

// Written from the I2C ISR, read from loop() -- hence volatile + a guarded copy.
volatile uint8_t  i2cData[NUM_THRUSTERS] = {127, 127, 127, 127, 127, 127, 127, 127};
volatile bool     newDataAvailable       = false;
volatile uint32_t lastI2CReceiveTime     = 0;
volatile bool     i2cFlashRequest        = false;

unsigned long startupTime          = 0;
bool          startupPhaseComplete = false;
bool          failsafeActive       = false;

// Test mode state
uint8_t       testModeChannelIndex = 0;
unsigned long lastTestModeStepTime = 0;

// LED
unsigned long lastLEDToggleTime = 0;
bool          ledState          = false;
unsigned long i2cFlashEndTime   = 0;
bool          i2cFlashActive    = false;

// ---------------------------------------------------------------------------
// FORWARD DECLARATIONS
// ---------------------------------------------------------------------------
void initPWM();
void initI2C();
void initLED();
void updateLED();
void ledWrite(bool on);
void updateThrusters();
void runThrusterTestMode();
void setThrusterMicros(uint8_t idx, uint16_t microseconds);
void setAllThrusters(uint16_t microseconds);
void i2cReceiveHandler(int numBytes);
void checkI2CTimeout();

// Map an 8-bit command (0-255) onto the ESC pulse range.
static inline uint16_t mapValueToThruster(uint8_t value) {
  const uint16_t range = THRUSTER_MAX_US - THRUSTER_MIN_US;
  return THRUSTER_MIN_US + (uint16_t)(((uint32_t)value * range) / 255);
}

// ---------------------------------------------------------------------------
// PWM
// ---------------------------------------------------------------------------

void initPWM() {
  timTIM1 = new HardwareTimer(TIM1);
  timTIM2 = new HardwareTimer(TIM2);
  timTIM3 = new HardwareTimer(TIM3);

  // Attach every channel in PWM mode. Passing the PinName lets the core pick
  // the right AF and, for PA7, recognise the complementary (CH1N) output.
  for (uint8_t i = 0; i < NUM_THRUSTERS; i++) {
    HardwareTimer *tim = timerFor(thrusters[i].timer);
    tim->setMode(thrusters[i].channel, TIMER_OUTPUT_COMPARE_PWM1, thrusters[i].pin);
  }

  // 50 Hz on each timer. Set the frequency once per timer (channels share it).
  timTIM1->setOverflow(THRUSTER_FREQUENCY, HERTZ_FORMAT);
  timTIM2->setOverflow(THRUSTER_FREQUENCY, HERTZ_FORMAT);
  timTIM3->setOverflow(THRUSTER_FREQUENCY, HERTZ_FORMAT);

  // Park at neutral BEFORE the timers start, so the very first edge an ESC
  // sees is already a valid 1500us arming pulse rather than a 0% duty glitch.
  for (uint8_t i = 0; i < NUM_THRUSTERS; i++) {
    setThrusterMicros(i, THRUSTER_NEUTRAL_US);
  }

  timTIM1->resume();
  timTIM2->resume();
  timTIM3->resume();
}

// Write one channel's pulse width in microseconds. MICROSEC_COMPARE_FORMAT
// makes the core convert us -> compare ticks using the timer's actual
// prescaler, so this stays correct regardless of clock config.
void setThrusterMicros(uint8_t idx, uint16_t microseconds) {
  if (idx >= NUM_THRUSTERS) return;
  uint16_t us = constrain(microseconds, THRUSTER_MIN_US, THRUSTER_MAX_US);
  HardwareTimer *tim = timerFor(thrusters[idx].timer);
  tim->setCaptureCompare(thrusters[idx].channel, us, MICROSEC_COMPARE_FORMAT);
}

void setAllThrusters(uint16_t microseconds) {
  for (uint8_t i = 0; i < NUM_THRUSTERS; i++) {
    setThrusterMicros(i, microseconds);
  }
}

// ---------------------------------------------------------------------------
// I2C
// ---------------------------------------------------------------------------

// ISR context: keep it short. Validate the header byte, then latch 8 values.
void i2cReceiveHandler(int numBytes) {
  if (numBytes != I2C_DATA_LENGTH) {
    while (Wire.available()) Wire.read();   // Wrong length -- discard frame
    return;
  }

  uint8_t header = Wire.read();
  if (header != I2C_HEADER_VALUE) {
    while (Wire.available()) Wire.read();   // Bad header -- discard frame
    return;
  }

  for (uint8_t i = 0; i < NUM_THRUSTERS; i++) {
    i2cData[i] = Wire.read();
  }

  newDataAvailable   = true;
  lastI2CReceiveTime = millis();
  i2cFlashRequest    = true;   // Flashed by updateLED(), not from the ISR
}

void initI2C() {
  Wire.setSCL(I2C_SCL_PIN);
  Wire.setSDA(I2C_SDA_PIN);
  Wire.begin(I2C_ADDRESS);          // Slave mode
  Wire.onReceive(i2cReceiveHandler);
  lastI2CReceiveTime = millis();
}

void updateThrusters() {
  if (!newDataAvailable) return;

  // Snapshot the ISR buffer with interrupts masked so a frame landing
  // mid-copy can't tear the values across two different commands.
  uint8_t local[NUM_THRUSTERS];
  noInterrupts();
  for (uint8_t i = 0; i < NUM_THRUSTERS; i++) local[i] = i2cData[i];
  newDataAvailable = false;
  interrupts();

  for (uint8_t i = 0; i < NUM_THRUSTERS; i++) {
    setThrusterMicros(i, mapValueToThruster(local[i]));
  }
}

// Failsafe: if the master goes quiet, fall back to neutral.
void checkI2CTimeout() {
  noInterrupts();
  uint32_t last = lastI2CReceiveTime;
  interrupts();

  if ((millis() - last) > I2C_TIMEOUT_MS) {
    if (!failsafeActive) {           // Edge-triggered: write once, not every loop
      setAllThrusters(THRUSTER_NEUTRAL_US);
      failsafeActive = true;
    }
  } else {
    failsafeActive = false;
  }
}

void runThrusterTestMode() {
  unsigned long now = millis();
  if ((now - lastTestModeStepTime) < THRUSTER_TEST_STEP_MS) {
    return;
  }

  lastTestModeStepTime = now;
  setAllThrusters(THRUSTER_TEST_IDLE_US);
  setThrusterMicros(testModeChannelIndex, THRUSTER_TEST_PULSE_US);
  testModeChannelIndex = (testModeChannelIndex + 1) % NUM_THRUSTERS;
}

// ---------------------------------------------------------------------------
// LED
// ---------------------------------------------------------------------------

void ledWrite(bool on) {
#if LED_ACTIVE_HIGH
  digitalWrite(LED_PIN, on ? HIGH : LOW);
#else
  digitalWrite(LED_PIN, on ? LOW : HIGH);
#endif
  ledState = on;
}

void initLED() {
  pinMode(LED_PIN, OUTPUT);
  ledWrite(false);
  lastLEDToggleTime = millis();
}

void updateLED() {
  unsigned long now = millis();

  // Boot: fast blink for a couple of seconds, then off.
  if (!startupPhaseComplete) {
    if ((now - startupTime) < LED_BOOT_FLASH_DURATION) {
      if (now - lastLEDToggleTime >= (LED_BOOT_FLASH_PERIOD / 2)) {
        ledWrite(!ledState);
        lastLEDToggleTime = now;
      }
    } else {
      ledWrite(false);
    }
    return;
  }

  // Normal operation: one short flash per accepted I2C frame.
  noInterrupts();
  bool flash = i2cFlashRequest;
  i2cFlashRequest = false;
  interrupts();

  if (flash) {
    ledWrite(true);
    i2cFlashActive  = true;
    i2cFlashEndTime = now + LED_I2C_FLASH_PERIOD;
  } else if (i2cFlashActive && now >= i2cFlashEndTime) {
    ledWrite(false);
    i2cFlashActive = false;
  }
}

// ---------------------------------------------------------------------------
// SETUP / LOOP
// ---------------------------------------------------------------------------

void setup() {
#if ENABLE_SERIAL
  Serial.begin(115200);
  delay(1000);
  Serial.println("\n=== STM32G431KBT6 I2C ESC Controller ===");
  Serial.print("I2C addr 0x"); Serial.print(I2C_ADDRESS, HEX);
  Serial.println(" on I2C2 (SCL=PA9, SDA=PA8)");
  Serial.print("Frame: "); Serial.print(I2C_DATA_LENGTH);
  Serial.println(" bytes [0x00][ESC1..ESC8]");
  Serial.print("PWM: "); Serial.print(THRUSTER_FREQUENCY); Serial.print(" Hz, ");
  Serial.print(THRUSTER_MIN_US); Serial.print('-'); Serial.print(THRUSTER_MAX_US);
  Serial.println(" us");
#if ENABLE_THRUSTER_TEST_MODE
  Serial.println("Thruster test mode enabled.");
  Serial.print("Each channel will be driven to "); Serial.print(THRUSTER_TEST_PULSE_US);
  Serial.print(" us for "); Serial.print(THRUSTER_TEST_STEP_MS);
  Serial.println(" ms in order.");
#endif
#endif

  initLED();
  initPWM();      // Outputs come up at neutral
  initI2C();

  startupTime          = millis();
  startupPhaseComplete = false;
}

void loop() {
  unsigned long now = millis();

  updateLED();

  // Startup: hold neutral so the ESCs arm. Ignore I2C commands during this.
  if (!startupPhaseComplete) {
    if ((now - startupTime) >= STARTUP_DELAY_MS) {
      startupPhaseComplete = true;
      noInterrupts();
      newDataAvailable   = false;         // Drop anything buffered while arming
      lastI2CReceiveTime = millis();      // Don't trip the failsafe immediately
      interrupts();
#if ENABLE_SERIAL
      Serial.println("Startup complete. Normal operation.");
#endif
    }
    delay(CYCLE_TIME_MS);
    return;
  }

#if ENABLE_THRUSTER_TEST_MODE
  runThrusterTestMode();
#else
  updateThrusters();
  checkI2CTimeout();
#endif

  delay(CYCLE_TIME_MS);
}
